/*###################################################################
### This PovRay document was generated by Inkscape
### http://www.inkscape.org
### Created: Sun Aug 14 11:30:58 2011
### Version: 0.48.1 r9760
#####################################################################
### NOTES:
### ============
### POVRay information can be found at
### http://www.povray.org
###
### The 'AllShapes' objects at the bottom are provided as a
### preview of how the output would look in a trace.  However,
### the main intent of this file is to provide the individual
### shapes for inclusion in a POV project.
###
### For an example of how to use this file, look at
### share/examples/istest.pov
###
### If you have any problems with this output, please see the
### Inkscape project at http://www.inkscape.org, or visit
### the #inkscape channel on irc.freenode.net . 
###
###################################################################*/


/*###################################################################
##   Exports in this file
##==========================
##    Shapes   : 1
##    Segments : 103
##    Nodes    : 824
###################################################################*/



/*###################################################
### PRISM:  rect3123
###################################################*/
#declare rect3123_MIN_X    = 0.00000000;
#declare rect3123_CENTER_X = 26.92187500;
#declare rect3123_MAX_X    = 53.84375000;
#declare rect3123_WIDTH    = 53.84375000;
#declare rect3123_MIN_Y    = 0.00000000;
#declare rect3123_CENTER_Y = 24.79687500;
#declare rect3123_MAX_Y    = 49.59375000;
#declare rect3123_HEIGHT   = 49.59375000;
#declare rect3123_SCALE    = 15.2/rect3123_WIDTH;
#declare rect3123_COLOR    = rgbf <1.00000000, 0.00000000, 0.00000000, 0.50000000>;
#declare rect3123 = prism {
    linear_sweep
    bezier_spline
    1.93, //top
    1.90, //bottom
    412 //nr points
    /*   0*/ <0.00000000, 49.59375000>, <0.00000000, 49.59375000>, <0.00000000, 46.93750000>, <0.00000000, 46.93750000>,
    /*   1*/ <0.00000000, 46.93750000>, <0.00000000, 46.93750000>, <1.06250000, 46.93750000>, <1.06250000, 46.93750000>,
    /*   2*/ <1.06250000, 46.93750000>, <1.45509840, 46.93750000>, <1.78125000, 46.64259800>, <1.78125000, 46.25000000>,
    /*   3*/ <1.78125000, 46.25000000>, <1.78125000, 46.25000000>, <1.78125000, 37.37500000>, <1.78125000, 37.37500000>,
    /*   4*/ <1.78125000, 37.37500000>, <1.78125000, 36.98240200>, <1.45509840, 36.68750000>, <1.06250000, 36.68750000>,
    /*   5*/ <1.06250000, 36.68750000>, <1.06250000, 36.68750000>, <0.00000000, 36.68750000>, <0.00000000, 36.68750000>,
    /*   6*/ <0.00000000, 36.68750000>, <0.00000000, 36.68750000>, <0.00000000, 31.00000000>, <0.00000000, 31.00000000>,
    /*   7*/ <0.00000000, 31.00000000>, <0.00000000, 31.00000000>, <3.37500000, 31.00000000>, <3.37500000, 31.00000000>,
    /*   8*/ <3.37500000, 31.00000000>, <3.76759840, 31.00000000>, <4.06250000, 30.67384800>, <4.06250000, 30.28125000>,
    /*   9*/ <4.06250000, 30.28125000>, <4.06250000, 30.28125000>, <4.06250000, 24.62500000>, <4.06250000, 24.62500000>,
    /*  10*/ <4.06250000, 24.62500000>, <4.06250000, 24.23240200>, <3.76759840, 23.90625000>, <3.37500000, 23.90625000>,
    /*  11*/ <3.37500000, 23.90625000>, <3.37500000, 23.90625000>, <0.00000000, 23.90625000>, <0.00000000, 23.90625000>,
    /*  12*/ <0.00000000, 23.90625000>, <0.00000000, 23.90625000>, <0.00000000, 21.78125000>, <0.00000000, 21.78125000>,
    /*  13*/ <0.00000000, 21.78125000>, <0.00000000, 21.78125000>, <1.06250000, 21.78125000>, <1.06250000, 21.78125000>,
    /*  14*/ <1.06250000, 21.78125000>, <1.45509840, 21.78125000>, <1.78125000, 21.48634840>, <1.78125000, 21.09375000>,
    /*  15*/ <1.78125000, 21.09375000>, <1.78125000, 21.09375000>, <1.78125000, 13.65625000>, <1.78125000, 13.65625000>,
    /*  16*/ <1.78125000, 13.65625000>, <1.78125000, 13.26365156>, <1.45509840, 12.93750000>, <1.06250000, 12.93750000>,
    /*  17*/ <1.06250000, 12.93750000>, <1.06250000, 12.93750000>, <0.00000000, 12.93750000>, <0.00000000, 12.93750000>,
    /*  18*/ <0.00000000, 12.93750000>, <0.00000000, 12.93750000>, <0.00000000, 0.00000000>, <0.00000000, 0.00000000>,
    /*  19*/ <0.00000000, 0.00000000>, <0.00000000, 0.00000000>, <49.96875000, 0.00000000>, <49.96875000, 0.00000000>,
    /*  20*/ <49.96875000, 0.00000000>, <49.96875000, 0.00000000>, <49.96875000, 2.31250000>, <49.96875000, 2.31250000>,
    /*  21*/ <49.96875000, 2.31250000>, <49.96875000, 3.68582400>, <47.46875000, 4.22042590>, <47.46875000, 5.59375000>,
    /*  22*/ <47.46875000, 5.59375000>, <47.46875000, 5.59375000>, <47.46875000, 33.90625000>, <47.46875000, 33.90625000>,
    /*  23*/ <47.46875000, 33.90625000>, <47.46875000, 35.58461300>, <49.96875000, 36.21274700>, <49.96875000, 38.28125000>,
    /*  24*/ <49.96875000, 38.28125000>, <49.96875000, 39.76326100>, <50.33721100, 40.75000000>, <51.75000000, 40.75000000>,
    /*  25*/ <51.75000000, 40.75000000>, <51.75000000, 40.75000000>, <53.84375000, 40.75000000>, <53.84375000, 40.75000000>,
    /*  26*/ <53.84375000, 40.75000000>, <53.84375000, 40.75000000>, <53.84375000, 46.06250000>, <53.84375000, 46.06250000>,
    /*  27*/ <53.84375000, 46.06250000>, <53.84375000, 46.06250000>, <49.25000000, 46.06250000>, <49.25000000, 46.06250000>,
    /*  28*/ <49.25000000, 46.06250000>, <49.25000000, 45.53100400>, <48.72933000, 45.34375000>, <48.37500000, 45.34375000>,
    /*  29*/ <48.37500000, 45.34375000>, <48.02066900, 45.34375000>, <47.46875000, 45.53233000>, <47.46875000, 45.96875000>,
    /*  30*/ <47.46875000, 45.96875000>, <47.46875000, 45.96875000>, <47.46875000, 49.59375000>, <47.46875000, 49.59375000>,
    /*  31*/ <47.46875000, 49.59375000>, <47.46875000, 49.59375000>, <0.00000000, 49.59375000>, <0.00000000, 49.59375000>,
    /*  32*/ <21.78125000, 48.18750000>, <21.78125000, 48.18750000>, <27.46875000, 48.18750000>, <27.46875000, 48.18750000>,
    /*  33*/ <27.46875000, 48.18750000>, <27.94486700, 48.18750000>, <28.21138300, 47.46875000>, <28.68750000, 47.46875000>,
    /*  34*/ <28.68750000, 47.46875000>, <28.68750000, 47.46875000>, <43.40625000, 47.46875000>, <43.40625000, 47.46875000>,
    /*  35*/ <43.40625000, 47.46875000>, <43.78438700, 47.46875000>, <44.28125000, 47.15938700>, <44.28125000, 46.78125000>,
    /*  36*/ <44.28125000, 46.78125000>, <44.28125000, 46.42691900>, <43.78414100, 46.07615900>, <43.40625000, 46.06250000>,
    /*  37*/ <43.40625000, 46.06250000>, <43.40625000, 46.06250000>, <28.68750000, 45.53125000>, <28.68750000, 45.53125000>,
    /*  38*/ <28.68750000, 45.53125000>, <27.57397800, 45.49100000>, <26.98925000, 47.31250000>, <25.87500000, 47.31250000>,
    /*  39*/ <25.87500000, 47.31250000>, <25.87500000, 47.31250000>, <23.37500000, 47.31250000>, <23.37500000, 47.31250000>,
    /*  40*/ <23.37500000, 47.31250000>, <23.04093400, 47.31250000>, <22.68750000, 46.92781600>, <22.68750000, 46.59375000>,
    /*  41*/ <22.68750000, 46.59375000>, <22.68750000, 46.59375000>, <22.68750000, 42.34375000>, <22.68750000, 42.34375000>,
    /*  42*/ <22.68750000, 42.34375000>, <22.68750000, 42.00968400>, <23.04093400, 41.62500000>, <23.37500000, 41.62500000>,
    /*  43*/ <23.37500000, 41.62500000>, <23.37500000, 41.62500000>, <25.87500000, 41.62500000>, <25.87500000, 41.62500000>,
    /*  44*/ <25.87500000, 41.62500000>, <27.05610200, 41.62500000>, <27.50716800, 43.79266300>, <28.68750000, 43.75000000>,
    /*  45*/ <28.68750000, 43.75000000>, <28.68750000, 43.75000000>, <43.40625000, 43.21875000>, <43.40625000, 43.21875000>,
    /*  46*/ <43.40625000, 43.21875000>, <43.78414000, 43.20509000>, <44.28125000, 42.90938700>, <44.28125000, 42.53125000>,
    /*  47*/ <44.28125000, 42.53125000>, <44.28125000, 42.17691900>, <43.78436000, 41.81705600>, <43.40625000, 41.81250000>,
    /*  48*/ <43.40625000, 41.81250000>, <43.40625000, 41.81250000>, <28.68750000, 41.62500000>, <28.68750000, 41.62500000>,
    /*  49*/ <28.68750000, 41.62500000>, <28.17952600, 41.61890000>, <27.97676100, 40.75000000>, <27.46875000, 40.75000000>,
    /*  50*/ <27.46875000, 40.75000000>, <27.46875000, 40.75000000>, <21.78125000, 40.75000000>, <21.78125000, 40.75000000>,
    /*  51*/ <21.78125000, 40.75000000>, <21.36366700, 40.75000000>, <20.90625000, 41.20741700>, <20.90625000, 41.62500000>,
    /*  52*/ <20.90625000, 41.62500000>, <20.90625000, 41.62500000>, <20.90625000, 47.31250000>, <20.90625000, 47.31250000>,
    /*  53*/ <20.90625000, 47.31250000>, <20.90625000, 47.73008300>, <21.36366700, 48.18750000>, <21.78125000, 48.18750000>,
    /*  54*/ <35.78125000, 32.93750000>, <35.78125000, 32.93750000>, <39.34375000, 32.93750000>, <39.34375000, 32.93750000>,
    /*  55*/ <39.34375000, 32.93750000>, <40.32524600, 32.93750000>, <41.09375000, 32.16899600>, <41.09375000, 31.18750000>,
    /*  56*/ <41.09375000, 31.18750000>, <41.09375000, 31.18750000>, <41.09375000, 20.90625000>, <41.09375000, 20.90625000>,
    /*  57*/ <41.09375000, 20.90625000>, <41.09375000, 19.92475390>, <40.32524600, 19.12500000>, <39.34375000, 19.12500000>,
    /*  58*/ <39.34375000, 19.12500000>, <39.34375000, 19.12500000>, <35.78125000, 19.12500000>, <35.78125000, 19.12500000>,
    /*  59*/ <35.78125000, 19.12500000>, <34.79975400, 19.12500000>, <34.03125000, 19.92475390>, <34.03125000, 20.90625000>,
    /*  60*/ <34.03125000, 20.90625000>, <34.03125000, 20.90625000>, <34.03125000, 31.18750000>, <34.03125000, 31.18750000>,
    /*  61*/ <34.03125000, 31.18750000>, <34.03125000, 32.16899600>, <34.79975400, 32.93750000>, <35.78125000, 32.93750000>,
    /*  62*/ <27.81250000, 31.71875000>, <28.14615700, 31.73527000>, <28.53125000, 31.33406600>, <28.53125000, 31.00000000>,
    /*  63*/ <28.53125000, 31.00000000>, <28.53125000, 30.66593400>, <28.14609400, 30.29899400>, <27.81250000, 30.28125000>,
    /*  64*/ <27.81250000, 30.28125000>, <27.81250000, 30.28125000>, <11.15625000, 29.40625000>, <11.15625000, 29.40625000>,
    /*  65*/ <11.15625000, 29.40625000>, <10.90605400, 29.39294000>, <10.62500000, 29.12555000>, <10.62500000, 28.87500000>,
    /*  66*/ <10.62500000, 28.87500000>, <10.62500000, 28.87500000>, <10.62500000, 27.46875000>, <10.62500000, 27.46875000>,
    /*  67*/ <10.62500000, 27.46875000>, <10.62500000, 27.21820000>, <10.90592700, 26.94815200>, <11.15625000, 26.93750000>,
    /*  68*/ <11.15625000, 26.93750000>, <11.15625000, 26.93750000>, <27.81250000, 26.21875000>, <27.81250000, 26.21875000>,
    /*  69*/ <27.81250000, 26.21875000>, <28.14626400, 26.20455000>, <28.53125000, 25.83406600>, <28.53125000, 25.50000000>,
    /*  70*/ <28.53125000, 25.50000000>, <28.53125000, 25.16593400>, <28.14615700, 24.79598200>, <27.81250000, 24.81250000>,
    /*  71*/ <27.81250000, 24.81250000>, <27.81250000, 24.81250000>, <9.90625000, 25.68750000>, <9.90625000, 25.68750000>,
    /*  72*/ <9.90625000, 25.68750000>, <9.57259230, 25.70402000>, <9.21875000, 26.07218400>, <9.21875000, 26.40625000>,
    /*  73*/ <9.21875000, 26.40625000>, <9.21875000, 26.40625000>, <9.21875000, 30.12500000>, <9.21875000, 30.12500000>,
    /*  74*/ <9.21875000, 30.12500000>, <9.21875000, 30.45906600>, <9.57259230, 30.79598200>, <9.90625000, 30.81250000>,
    /*  75*/ <9.90625000, 30.81250000>, <9.90625000, 30.81250000>, <27.81250000, 31.71875000>, <27.81250000, 31.71875000>,
    /*  76*/ <35.78125000, 17.00000000>, <35.78125000, 17.00000000>, <39.34375000, 17.00000000>, <39.34375000, 17.00000000>,
    /*  77*/ <39.34375000, 17.00000000>, <40.32524600, 17.00000000>, <41.09375000, 16.23149610>, <41.09375000, 15.25000000>,
    /*  78*/ <41.09375000, 15.25000000>, <41.09375000, 15.25000000>, <41.09375000, 4.96875000>, <41.09375000, 4.96875000>,
    /*  79*/ <41.09375000, 4.96875000>, <41.09375000, 3.98725400>, <40.32524600, 3.18750000>, <39.34375000, 3.18750000>,
    /*  80*/ <39.34375000, 3.18750000>, <39.34375000, 3.18750000>, <35.78125000, 3.18750000>, <35.78125000, 3.18750000>,
    /*  81*/ <35.78125000, 3.18750000>, <34.79975400, 3.18750000>, <34.03125000, 3.98725400>, <34.03125000, 4.96875000>,
    /*  82*/ <34.03125000, 4.96875000>, <34.03125000, 4.96875000>, <34.03125000, 15.25000000>, <34.03125000, 15.25000000>,
    /*  83*/ <34.03125000, 15.25000000>, <34.03125000, 16.23149610>, <34.79975400, 17.00000000>, <35.78125000, 17.00000000>,
    /*  84*/ <1.78125000, 10.62500000>, <1.78125000, 10.62500000>, <18.06250000, 10.62500000>, <18.06250000, 10.62500000>,
    /*  85*/ <18.06250000, 10.62500000>, <18.39656600, 10.62500000>, <18.78125000, 10.24031640>, <18.78125000, 9.90625000>,
    /*  86*/ <18.78125000, 9.90625000>, <18.78125000, 9.90625000>, <18.78125000, 8.50000000>, <18.78125000, 8.50000000>,
    /*  87*/ <18.78125000, 8.50000000>, <18.78125000, 8.16593370>, <18.39648000, 7.78884050>, <18.06250000, 7.78125000>,
    /*  88*/ <18.06250000, 7.78125000>, <18.06250000, 7.78125000>, <10.28125000, 7.62500000>, <10.28125000, 7.62500000>,
    /*  89*/ <10.28125000, 7.62500000>, <9.93699120, 7.61718000>, <9.71934770, 7.09375000>, <9.37500000, 7.09375000>,
    /*  90*/ <9.37500000, 7.09375000>, <9.37500000, 7.09375000>, <7.09375000, 7.09375000>, <7.09375000, 7.09375000>,
    /*  91*/ <7.09375000, 7.09375000>, <6.84320040, 7.09375000>, <6.56250000, 7.37445040>, <6.56250000, 7.62500000>,
    /*  92*/ <6.56250000, 7.62500000>, <6.56250000, 8.15649610>, <5.65649060, 8.49760320>, <5.12500000, 8.50000000>,
    /*  93*/ <5.12500000, 8.50000000>, <4.25196850, 8.50393700>, <3.53125000, 7.79207680>, <3.53125000, 6.90625000>,
    /*  94*/ <3.53125000, 6.90625000>, <3.53125000, 6.02042320>, <4.25196850, 5.31250000>, <5.12500000, 5.31250000>,
    /*  95*/ <5.12500000, 5.31250000>, <5.12500000, 5.31250000>, <18.06250000, 5.31250000>, <18.06250000, 5.31250000>,
    /*  96*/ <18.06250000, 5.31250000>, <18.39656600, 5.31250000>, <18.78125000, 4.92781630>, <18.78125000, 4.59375000>,
    /*  97*/ <18.78125000, 4.59375000>, <18.78125000, 4.59375000>, <18.78125000, 4.25000000>, <18.78125000, 4.25000000>,
    /*  98*/ <18.78125000, 4.25000000>, <18.78125000, 3.91593300>, <18.39656600, 3.53125000>, <18.06250000, 3.53125000>,
    /*  99*/ <18.06250000, 3.53125000>, <18.06250000, 3.53125000>, <1.78125000, 3.53125000>, <1.78125000, 3.53125000>,
    /* 100*/ <1.78125000, 3.53125000>, <1.44718380, 3.53125000>, <1.06250000, 3.91593300>, <1.06250000, 4.25000000>,
    /* 101*/ <1.06250000, 4.25000000>, <1.06250000, 4.25000000>, <1.06250000, 9.90625000>, <1.06250000, 9.90625000>,
    /* 102*/ <1.06250000, 9.90625000>, <1.06250000, 10.24031620>, <1.44718380, 10.62500000>, <1.78125000, 10.62500000>
  scale <rect3123_SCALE,1,rect3123_SCALE>
}
/*###################################################
### end rect3123
###################################################*/

#declare MicroSDPin = prism {
    linear_sweep
    bezier_spline
    0.3, //top
    0.0, //bottom
    40 //nr points
    /*   0*/ <0.00000000, -0.00001738>, <0.00000000, -0.00001738>, <0.00000000, 0.55838262>, <0.00000000, 0.55838262>,
    /*   1*/ <0.00000000, 0.55838262>, <0.00000000, 0.55838262>, <-3.70542800, 1.40398262>, <-3.70542800, 1.40398262>,
    /*   2*/ <-3.70542800, 1.40398262>, <-3.70542800, 1.40398262>, <-13.82296300, 1.08068262>, <-13.82296300, 1.08068262>,
    /*   3*/ <-13.82296300, 1.08068262>, <-13.82296300, 1.08068262>, <-23.58858500, 2.64738262>, <-23.58858500, 2.64738262>,
    /*   4*/ <-23.58858500, 2.64738262>, <-23.58858500, 2.64738262>, <-27.19570600, 2.64738262>, <-27.19570600, 2.64738262>,
    /*   5*/ <-27.19570600, 2.64738262>, <-27.19570600, 2.64738262>, <-27.19570600, 2.10028262>, <-27.19570600, 2.10028262>,
    /*   6*/ <-27.19570600, 2.10028262>, <-27.19570600, 2.10028262>, <-23.58858500, 1.72728262>, <-23.58858500, 1.72728262>,
    /*   7*/ <-23.58858500, 1.72728262>, <-23.58858500, 1.72728262>, <-13.82296300, 0.60818262>, <-13.82296300, 0.60818262>,
    /*   8*/ <-13.82296300, 0.60818262>, <-13.82296300, 0.60818262>, <-3.70542800, -0.00001738>, <-3.70542800, -0.00001738>,
    /*   9*/ <-3.70542800, -0.00001738>, <-3.70542800, -0.00001738>, <0.00000000, -0.00001738>, <0.00000000, -0.00001738>
  scale <rect3123_SCALE,1,rect3123_SCALE>
  translate z*0.15
}



/*###################################################
### UNION OF ALL SHAPES IN DOCUMENT
###################################################*/


/**
 * Allow the user to redefine the finish{}
 * by declaring it before #including this file
 */
#ifndef (AllShapes_Finish)
#declare AllShapes_Finish = finish {
    phong 0.5
    reflection 0.3
    specular 0.5
}
#end


#declare AllShapes = union {
    object { rect3123
        texture { 
            pigment { rgbf <1.00000000, 0.00000000, 0.00000000, 0.50000000> }
            finish { AllShapes_Finish }
            } 
        } 
}



/*#### Same union, but with Z-diffs (actually Y in pov) ####*/


/**
 * Allow the user to redefine the Z-Increment
 */
#ifndef (AllShapes_Z_Increment)
#declare AllShapes_Z_Increment = 0.20000000;
#end

#declare AllShapes_Z_Scale = 1.0;


#declare AllShapes_Z = union {
    object { rect3123
        texture { 
            pigment { rgbf <1.00000000, 0.00000000, 0.00000000, 0.50000000> }
            finish { AllShapes_Finish }
            } 
        scale <1, AllShapes_Z_Scale, 1>
        } 
#declare AllShapes_Z_Scale = AllShapes_Z_Scale + AllShapes_Z_Increment;

}
#declare AllShapes_MIN_X    = 0.00000000;
#declare AllShapes_CENTER_X = 26.92187500;
#declare AllShapes_MAX_X    = 53.84375000;
#declare AllShapes_WIDTH    = 53.84375000;
#declare AllShapes_MIN_Y    = 0.00000000;
#declare AllShapes_CENTER_Y = 24.79687500;
#declare AllShapes_MAX_Y    = 49.59375000;
#declare AllShapes_HEIGHT   = 49.59375000;
/*##############################################
### end AllShapes
##############################################*/




/*###################################################################
### E N D    F I L E
###################################################################*/


